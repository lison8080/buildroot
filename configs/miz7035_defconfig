## configs/miz7035_defconfig
```kconfig
# MIZ7035 (Zynq-7000 XC7Z035) — Buildroot defconfig
#
# 目标板：米联客 MIZ7035（核心板 XC7Z035 + Fun 底板）
# 存储：eMMC 8GB（mmcblk0）= 根文件系统 + 启动文件；QSPI 32MiB = BOOT.BIN/kernel/env/ramdisk 兜底
#
# 工具链：仓库内自带的 Vitis aarch32 工具链（linux/toolchain/gcc-arm-linux-gnueabi）
#   - gcc 13.4.0，glibc 2.39，Cortex-A9 hard-float + NEON
#   - 与板上已有 rootfs 的 glibc 版本一致，app/驱动 也用同一套编译
#
# 与 PetaLinux 方案的对应关系：
#   PetaLinux            -> 本 defconfig
#   u-boot-xlnx + FSBL   -> BR2_TARGET_UBOOT（SPL 方案，见 README）
#   linux-xlnx           -> BR2_LINUX_KERNEL（同源码树、同 defconfig）
#   system-user.dtsi     -> board/miz7035/dts（内核树内 zynq-miz7035.dts）
#   rootfs + 定制        -> BR2_ROOTFS_OVERLAY（zsh/OMZ/init 脚本/驱动/app）

# ---------------------------------------------------------------- 工具链（Buildroot 自建，可导出 SDK）
# 为什么自建而不是用 Vitis aarch32 外部工具链：
#   1) Buildroot 对外部工具链的 sysroot 布局检测在本机反复失败（工具链 sysroot 是非标准分层）
#   2) 自建工具链保证 glibc / libstdc++ / 内核头 与 rootfs 完全一致，
#      app 与内核模块用同一套编译绝对不会出现运行期 ABI 不匹配
#   3) `make sdk` 可直接导出可搬迁工具链，满足"统一放在 linux/toolchain 下"的要求
# 版本选择：gcc 16.2（最新）+ glibc 2.44；整套 rootfs/app/驱动 全部用同一套工具链重编，
#           因此不再需要迁就旧 rootfs 的 glibc 2.39
BR2_TOOLCHAIN_BUILDROOT=y
BR2_TOOLCHAIN_BUILDROOT_GLIBC=y
BR2_TOOLCHAIN_BUILDROOT_CXX=y
BR2_GCC_VERSION_16_X=y
BR2_KERNEL_HEADERS_6_18=y
BR2_TOOLCHAIN_BUILDROOT_LOCALE=y
BR2_TOOLCHAIN_BUILDROOT_WCHAR=y
BR2_PTHREAD_DEBUG=y
BR2_PTHREADS_NATIVE=y

# ---------------------------------------------------------------- 架构
BR2_arm=y
BR2_cortex_a9=y
BR2_ARM_ENABLE_NEON=y
BR2_ARM_ENABLE_VFP=y
BR2_ARM_FPU_VFPV3D16=y


# ---------------------------------------------------------------- 系统
BR2_TARGET_GENERIC_HOSTNAME="z7035_plnx"
BR2_TARGET_GENERIC_ISSUE="MIZ7035 (Zynq-7000 XC7Z035) Buildroot"
BR2_TARGET_GENERIC_ROOT_PASSWD="0000"
BR2_SYSTEM_DHCP=""
BR2_TARGET_GENERIC_GETTY_PORT="ttyPS0"
BR2_TARGET_GENERIC_GETTY_BAUDRATE_115200=y
BR2_TARGET_GENERIC_GETTY_TERM="xterm"
BR2_SYSTEM_BIN_SH_BASH=y
BR2_ROOTFS_USERS_TABLES=""
BR2_TARGET_LOCALTIME="Asia/Shanghai"
# 生成 UTF-8 locale（zsh 多字节/中文显示依赖，缺失会刷 setlocale 警告）
BR2_GENERATE_LOCALE="C.UTF-8 en_US.UTF-8"

# 串口控制台：与现有板子一致（ttyPS0 115200）
BR2_TARGET_GENERIC_GETTY=y

# ---------------------------------------------------------------- 根文件系统
BR2_TARGET_ROOTFS_EXT2=y
BR2_TARGET_ROOTFS_EXT2_4=y
BR2_TARGET_ROOTFS_EXT2_SIZE="512M"
BR2_TARGET_ROOTFS_EXT2_LABEL="rootfs"
BR2_ROOTFS_OVERLAY="board/miz7035/rootfs-overlay"
BR2_ROOTFS_POST_BUILD_SCRIPT="board/miz7035/post-build.sh"
BR2_ROOTFS_POST_IMAGE_SCRIPT="board/miz7035/post-image.sh"

# ---------------------------------------------------------------- 内核（本地源码树）
BR2_LINUX_KERNEL=y
BR2_LINUX_KERNEL_CUSTOM_VERSION=n
BR2_LINUX_KERNEL_CUSTOM_GIT=n
BR2_LINUX_KERNEL_CUSTOM_TARBALL=n
BR2_LINUX_KERNEL_DEFCONFIG="xilinx_zynq"
BR2_LINUX_KERNEL_DEFCONFIG_EXT=""
BR2_LINUX_KERNEL_CONFIG_FRAGMENT_FILES=""
BR2_LINUX_KERNEL_DTS_SUPPORT=y
BR2_LINUX_KERNEL_INTREE_DTS_NAME="xilinx/zynq-miz7035"
BR2_LINUX_KERNEL_INSTALL_TARGET=y
BR2_LINUX_KERNEL_NEEDS_HOST_OPENSSL=y
BR2_LINUX_KERNEL_NEEDS_HOST_LIBELF=y
BR2_LINUX_KERNEL_UIMAGE=y
BR2_LINUX_KERNEL_UIMAGE_LOADADDR="0x8000"

# 内核模块：tdp_mem 用内核头文件外部编译（见 README），此处不内置

# ---------------------------------------------------------------- U-Boot（本地源码树）
BR2_TARGET_UBOOT=y
BR2_TARGET_UBOOT_BUILD_SYSTEM_KCONFIG=y
BR2_TARGET_UBOOT_CUSTOM_VERSION=n
BR2_TARGET_UBOOT_CUSTOM_GIT=n
BR2_TARGET_UBOOT_CUSTOM_TARBALL=n
BR2_TARGET_UBOOT_BOARD_DEFCONFIG="xilinx_zynq_miz7035"
BR2_TARGET_UBOOT_NEEDS_DTC=y
BR2_TARGET_UBOOT_NEEDS_OPENSSL=y
BR2_TARGET_UBOOT_NEEDS_PYTHON3=y
BR2_TARGET_UBOOT_NEEDS_PYLIBFDT=y
BR2_TARGET_UBOOT_NEEDS_PYELFTOOLS=y
BR2_TARGET_UBOOT_NEEDS_GNU_EFI=y
BR2_TARGET_UBOOT_FORMAT_ELF=y
BR2_TARGET_UBOOT_SPL=y
BR2_TARGET_UBOOT_SPL_NAME="spl/boot.bin"
BR2_TARGET_UBOOT_CUSTOM_MAKEOPTS=""

# ---------------------------------------------------------------- 常用工具（对齐现有 PetaLinux rootfs）
BR2_PACKAGE_BUSYBOX_SHOW_OTHERS=y
BR2_PACKAGE_BASH=y
BR2_PACKAGE_ZSH=y
BR2_PACKAGE_GIT=y
BR2_PACKAGE_VIM=y
BR2_PACKAGE_HTOP=y
BR2_PACKAGE_DROPBEAR=y
BR2_PACKAGE_OPENSSH=y
BR2_PACKAGE_IPROUTE2=y
BR2_PACKAGE_ETHTOOL=y
BR2_PACKAGE_KMOD=y
BR2_PACKAGE_KMOD_TOOLS=y
BR2_PACKAGE_DOSFSTOOLS=y
BR2_PACKAGE_E2FSPROGS=y
BR2_PACKAGE_E2FSPROGS_RESIZE2FS=y
BR2_PACKAGE_E2FSPROGS_TUNE2FS=y
BR2_PACKAGE_MTD=y
BR2_PACKAGE_UTIL_LINUX=y
BR2_PACKAGE_USBUTILS=y
BR2_PACKAGE_FILE=y
BR2_PACKAGE_LESS=y
BR2_PACKAGE_NANO=y
BR2_PACKAGE_STRACE=y
BR2_PACKAGE_HWCLOCK=y
BR2_PACKAGE_RSYNC=y
BR2_PACKAGE_TAR=y
BR2_PACKAGE_GZIP=y
BR2_PACKAGE_XZ=y
BR2_PACKAGE_BZIP2=y
BR2_PACKAGE_ZIP=y
BR2_PACKAGE_UNZIP=y
BR2_PACKAGE_LIBCURL=y
BR2_PACKAGE_LIBCURL_CURL=y
BR2_PACKAGE_WGET=y
BR2_PACKAGE_PYTHON3=y


# ---------------------------------------------------------------- 板级包（br2-external）
# tdp_mem 内核模块 + z7035_app 由 Buildroot 统一编译安装，
# 保证与内核/glibc 版本严格一致，无需手工 scp。
BR2_PACKAGE_TDP_MEM=y
BR2_PACKAGE_Z7035_APP=y

# ---------------------------------------------------------------- 主机端工具
BR2_PACKAGE_HOST_DOSFSTOOLS=y
BR2_PACKAGE_HOST_E2FSPROGS=y
BR2_PACKAGE_HOST_GENIMAGE=y
BR2_PACKAGE_HOST_MTOOLS=y
BR2_PACKAGE_HOST_UBOOT_TOOLS=y
```
